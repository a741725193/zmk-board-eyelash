## boards/arm/eyelash_nano/Kconfig.board
```kconfig
#
# Copyright (c) 2024 The ZMK Contributors
# SPDX-License-Identifier: MIT
#

config BOARD_EYELASH_NANO
    bool "eyelash_nano"
    depends on SOC_NRF52840_QIAA
```

## boards/arm/eyelash_nano/Kconfig.defconfig
```kconfig
# Copyright (c) 2021 The ZMK Contributors
# SPDX-License-Identifier: MIT

if BOARD_EYELASH_NANO

config BOARD
    default "eyelash_nano"

if USB_DEVICE_STACK

config USB_NRFX
    default y

endif # USB_DEVICE_STACK

config BT_CTLR
    default BT

endif # BOARD_EYELASH_NANO
```

## boards/arm/eyelash_nano_v2/Kconfig.board
```kconfig
#
# Copyright (c) 2024 The ZMK Contributors
# SPDX-License-Identifier: MIT
#

config BOARD_EYELASH_NANO_V2
    bool "eyelash nano board"
    depends on SOC_NRF52832_QFAA
```

## boards/arm/eyelash_nano_v2/Kconfig.defconfig
```kconfig
# Copyright (c) 2021 The ZMK Contributors
# SPDX-License-Identifier: MIT

if BOARD_EYELASH_NANO_V2

config BOARD
    default "eyelash_nano_v2"

config BT_CTLR
    default BT

endif # BOARD_EYELASH_NANO
```

## boards/arm/eyelash_nano_v2/eyelash_nano_v2_defconfig
```kconfig
# SPDX-License-Identifier: MIT
CONFIG_SOC_SERIES_NRF52X=y
CONFIG_SOC_NRF52832_QFAA=y

# enable GPIO
CONFIG_GPIO=y

# Enable i2c
CONFIG_I2C=y

# Enable MPU
CONFIG_ARM_MPU=y

CONFIG_ZMK_BLE=y

# Enable 32kHz crystal
CONFIG_CLOCK_CONTROL_NRF_K32SRC_XTAL=y
CONFIG_CLOCK_CONTROL_NRF_K32SRC_30PPM=y
```

## boards/shields/aw/Kconfig.defconfig
```kconfig
if SHIELD_OFFSETKEY
config ZMK_KEYBOARD_NAME
	default "aw"
endif
config I2C
    default y
```

## config/west.yml
```yaml
manifest:
  remotes:
    - name: zmkfirmware
      url-base: https://github.com/zmkfirmware
    - name: eyelash
      url-base: https://github.com/a741725193
    # Additional modules containing boards/shields/custom code can be listed here as well
    # See https://docs.zephyrproject.org/3.2.0/develop/west/manifest.html#projects
  projects:
    - name: zmk
      remote: zmkfirmware
      revision: main
      import: app/west.yml
    - name: zmk-board-eyelash
      remote: eyelash
      revision: main
  self:
    path: config
```
